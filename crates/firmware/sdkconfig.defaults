## crates/firmware/sdkconfig.defaults
```kconfig
# Rust typically needs more stack space than the ESP-IDF C defaults.
# Increase CONFIG_ESP_MAIN_TASK_STACK_SIZE further if you see stack overflow panics.
CONFIG_ESP_MAIN_TASK_STACK_SIZE=8192
CONFIG_ESP_SYSTEM_EVENT_TASK_STACK_SIZE=4096
CONFIG_FREERTOS_IDLE_TASK_STACKSIZE=4096
CONFIG_PTHREAD_TASK_STACK_SIZE_DEFAULT=4096

# TinyUSB: enable a single HID interface (keyboard + mouse + consumer on one
# interface via report IDs — see components/tinyusb_bridge/tinyusb_bridge.c).
CONFIG_TINYUSB_HID_COUNT=1

# The default 1 MB app partition is too small for Wi-Fi + TinyUSB + Rust std.
# Use a custom partition table with a 3 MB factory app slot.
CONFIG_PARTITION_TABLE_CUSTOM=y
CONFIG_PARTITION_TABLE_CUSTOM_FILENAME="partitions.csv"
CONFIG_ESPTOOLPY_FLASHSIZE_16MB=y
```
